## board/asus/imx8mp_blizzard/Kconfig
```kconfig
if TARGET_IMX8MP_BLIZZARD || TARGET_IMX8MP_BLIZZARD_4G

config SYS_BOARD
	default "imx8mp_blizzard"

config SYS_VENDOR
	default "asus"

config SYS_CONFIG_NAME
	default "imx8mp_blizzard"

config IMX_CONFIG
	default "board/asus/imx8mp_blizzard/imximage-8mp-lpddr4.cfg"

source "board/asus/common/Kconfig"

endif
```

## board/asus/imx8mq_ima/Kconfig
```kconfig
if TARGET_IMX8MQ_IMA

config SYS_BOARD
	default "imx8mq_ima"

config SYS_VENDOR
	default "asus"

config SYS_CONFIG_NAME
	default "imx8mq_ima"

source "board/freescale/common/Kconfig"

endif
```

## board/asus/imx8mq_p100ivm/Kconfig
```kconfig
if TARGET_IMX8MQ_P100IVM

config SYS_BOARD
	default "imx8mq_p100ivm"

config SYS_VENDOR
	default "asus"

config SYS_CONFIG_NAME
	default "imx8mq_p100ivm"

source "board/freescale/common/Kconfig"

endif
```

## board/asus/imx8mq_pe100a/Kconfig
```kconfig
if TARGET_IMX8MQ_PE100A

config SYS_BOARD
	default "imx8mq_pe100a"

config SYS_VENDOR
	default "asus"

config SYS_CONFIG_NAME
	default "imx8mq_pe100a"

source "board/freescale/common/Kconfig"

endif
```
